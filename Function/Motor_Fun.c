/***************************************************************************************************
*FileName:
*Description:
*Author: xsx_kair
*Data:
***************************************************************************************************/

/***************************************************************************************************/
/******************************************Header List********************************************/
/***************************************************************************************************/
#include	"Motor_Fun.h"
#include	"Motor_Data.h"
#include	"Timer4_Driver.h"
#include	"CardLimit_Driver.h"
#include	"DRV8825_Driver.h"
#include	"Motor.h"

#include 	"FreeRTOS.h"
#include 	"task.h"
#include 	"queue.h"
#include	"semphr.h"

#include	<string.h>
#include	"stdio.h"
#include 	"stdlib.h"
/***************************************************************************************************/
/***************************************************************************************************/
/***************************************************************************************************/
extern Motor GB_Motors;
/***************************************************************************************************/
/***************************************************************************************************/
/***************************************************************************************************/

/***************************************************************************************************/
/***************************************************************************************************/
/***************************************************************************************************/
/****************************************File Start*************************************************/
/***************************************************************************************************/
/***************************************************************************************************/
void MotorMoveTo(unsigned char highTime, unsigned char lowTime, unsigned int location, MyBool isWait)
{
	if(GB_Motors.motorLocation == location)
		return;
	else if(GB_Motors.motorLocation > location)
		GB_Motors.isFront = FALSE;
	else
		GB_Motors.isFront = TRUE;

	if(GB_Motors.isFront)
		SetDRVDir(Forward);
	else
		SetDRVDir(Reverse);
	//vTaskDelay(10 / portTICK_RATE_MS);
	
	GB_Motors.periodCnt = 0;
	GB_Motors.parm1 = 0;
	GB_Motors.highTime = highTime;
	GB_Motors.lowTime = lowTime;
	GB_Motors.motorTargetLocation = location;
	GB_Motors.moveStepNum = 60000;

	while(isWait && GB_Motors.motorLocation != GB_Motors.motorTargetLocation)
	{
		vTaskDelay(1 / portTICK_RATE_MS);
	}
}

void StopMotor(void)
{
	StopTimer4();
}
/****************************************end of file************************************************/

